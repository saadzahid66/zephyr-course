## app/boards/my_board/Kconfig.my_board
```kconfig
config BOARD_MY_BOARD
    select SOC_STM32F446XX if BOARD_MY_BOARD
    select BOARD_EARLY_INIT_HOOK
```

## app/boards/our_boards/Kconfig.our_board
```kconfig
# Copyright (c) 2021 Tom Owen
# SPDX-License-Identifier: Apache-2.0

config BOARD_OUR_BOARD
	select SOC_STM32F446XX if BOARD_OUR_BOARD
```
